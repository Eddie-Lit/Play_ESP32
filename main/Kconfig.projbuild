## main/Kconfig.projbuild
```kconfig
menu "Example Configuration"

    config BLINK_GPIO
        int "Blink GPIO number"
        range 0 48
        default 2
        help
            GPIO number (IOxx) to blink on and off the LED.
            Default is GPIO 2 for typical ESP32 DevKit onboard LED.

    config BLINK_PERIOD
        int "Blink period in ms"
        range 10 3600000
        default 1000
        help
            Define the blinking period in milliseconds.

endmenu
```

## sdkconfig.defaults
```kconfig
# Application configuration
CONFIG_BLINK_GPIO=2

# Bluetooth configuration (NimBLE)
CONFIG_BT_ENABLED=y
CONFIG_BTDM_CTRL_MODE_BLE_ONLY=y
CONFIG_BTDM_CTRL_MODE_BR_EDR_ONLY=n
CONFIG_BTDM_CTRL_MODE_BTDM=n
CONFIG_BT_BLUEDROID_ENABLED=n
CONFIG_BT_NIMBLE_ENABLED=y

# Expand partition to 1.5MB for Bluetooth firmware
CONFIG_PARTITION_TABLE_SINGLE_APP_LARGE=y
```
